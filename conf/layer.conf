## conf/layer.conf
```bitbake
# We have a conf and classes directory, add to BBPATH
BBPATH .= ":${LAYERDIR}"

# We have recipes-* directories, add to BBFILES
BBFILES += "${LAYERDIR}/recipes-*/*/*.bb \
            ${LAYERDIR}/recipes-*/*/*.bbappend"

BBFILE_COLLECTIONS += "atmel"
BBFILE_PATTERN_atmel = "^${LAYERDIR}/"
BBFILE_PRIORITY_atmel = "10"
LAYERSERIES_COMPAT_atmel = "thud"
```

## conf/machine/at91sam9x5.conf
```bitbake
#@TYPE: Machine
#@Name: at91sam9x5
#@DESCRIPTION: at91sam9x5

require conf/machine/include/soc-family.inc
require conf/machine/include/tune-arm926ejs.inc

SOC_FAMILY = "at91sam9"
MACHINE_FEATURES = "wifi serial"
MACHINE_EXTRA_RRECOMMENDS = " kernel-modules kernel-devicetree"

PREFERRED_PROVIDER_virtual/kernel = "linux-yocto"
PREFERRED_VERSION_virtual/kernel = "4.19"
KERNEL_CLASSES += "kernel-fitimage"
KERNEL_IMAGETYPE ?= "fitImage"
KERNEL_DEVICETREE_at91sam9 = "gardena_smart_gateway_at91sam.dtb"
SERIAL_CONSOLES ?= "115200;ttyS0"

PREFERRED_VERSION_u-boot = "2019.07"
PREFERRED_VERSION_u-boot-fw-utils = "2019.07"
PREFERRED_VERSION_u-boot-mkimage = "2019.07"
UBOOT_CONFIG ??= "rom"
UBOOT_CONFIG[rom] = "gardena-smart-gateway-at91sam_defconfig"
UBOOT_ENTRYPOINT = "0x20008000"
UBOOT_LOADADDRESS = "0x20008000"
UBOOT_ENV_SIZE = "0x20000"
SPL_BINARY = "u-boot-with-spl.bin"
```

## conf/machine/gardena-sg-at91sam.conf
```bitbake
#@TYPE: Machine
#@Name: gardena-sg-at91sam
#@DESCRIPTION: gardena-sg-at91sam

require conf/machine/include/soc-family.inc
require conf/machine/include/tune-arm926ejs.inc

SOC_FAMILY = "at91sam9"
MACHINE_FEATURES = "wifi serial"
MACHINE_EXTRA_RRECOMMENDS = " kernel-modules kernel-devicetree"
MACHINEOVERRIDES =. "at91sam9x5:"

PREFERRED_PROVIDER_virtual/kernel = "linux-yocto-tiny"
PREFERRED_VERSION_virtual/kernel = "5.8"
KERNEL_CLASSES += "kernel-fitimage"
KERNEL_IMAGETYPE ?= "fitImage"
KERNEL_DEVICETREE_at91sam9 = "at91sam9g25-gardena-smart-gateway.dtb"
SERIAL_CONSOLES ?= "115200;ttyS0"

UBOOT_CONFIG ??= "rom"
UBOOT_CONFIG[rom] = "gardena-smart-gateway-at91sam_defconfig"
UBOOT_ENTRYPOINT = "0x20008000"
UBOOT_LOADADDRESS = "0x20008000"
UBOOT_ENV_SIZE = "0x20000"
SPL_BINARY = "u-boot-with-spl.bin"

RADIO_MODULE_PPP_TTY = "/dev/ttyS1"
HOMEKIT_HWAUTH = "0"
HOMEKIT_SWAUTH_LS_URL_PROD = "https://prod.gardena.deviceauth.io"
HOMEKIT_SWAUTH_LS_URL_QA   = "https://prod.gardena.deviceauth.io"
HOMEKIT_SWAUTH_LS_URL_DEV  = "https://dev.gardena.deviceauth.io"

IMAGE_INSTALL += " \
    kernel-module-rtl8192cu \
    kernel-module-rtl8xxxu \
    linux-firmware-rtl8192cu \
"

# Don't include kernels in standard images
RDEPENDS_${KERNEL_PACKAGE_NAME}-base = ""
```
